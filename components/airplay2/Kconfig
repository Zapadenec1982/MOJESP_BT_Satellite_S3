## components/cover/Kconfig
```kconfig
menu "Cover art"

    config COVER_DECODE_TILE
        bool "Decode artwork into an RGB565 tile for a display"
        depends on SOC_JPEG_CODEC_SUPPORTED && SOC_PPA_SUPPORTED
        default y
        help
            On: every cover is decoded once (the JPEG engine, with stb_image for what it
            cannot read, and the PPA to scale) into a 280x280 RGB565 tile that a display draws
            and the web's GET /api/cover rebuilds a BMP from. What the P4 panel runs; it needs
            both engines, so a chip without them (the ESP32-S3) has only the mode below.

            Off: the cover is kept as the file that arrived, JPEG or PNG, and handed to the
            web as it is (cover_bytes_get); the browser decodes it. Its colour for the web's
            backdrop comes from an eighth-scale decode by the ROM's TJpgDec where the chip
            has one (baseline JPEG; none for PNG or progressive). For a board without a
            display: no tile memory, no software decoder, no seconds of CPU per cover.

endmenu
```

## components/hosted_mem/Kconfig
```kconfig
menu "ESP-Hosted frame copies (hosted_mem)"
    depends on ESP_HOSTED_HOST

    config HOSTED_MEM_FRAMES_IN_PSRAM
        bool "Keep esp_hosted's per-frame copies in PSRAM"
        depends on SPIRAM
        default y
        help
            esp_hosted 3.0.7 copies every received and every sent frame into a buffer from
            eh_host_port_dma_alloc(), which is internal DMA-capable SRAM. Up to 20 received
            frames (~33 KB) can be held at once, and when the allocation fails the frame is
            dropped without a log line. With this option those copies come from PSRAM; the
            SDIO transfers themselves are untouched. See components/hosted_mem/hosted_mem.c.

            Turning it off restores esp_hosted's own allocation exactly; the drop counters
            stay available either way.

endmenu
```

## components/net_probe/Kconfig
```kconfig
menu "Network probe (bench images only)"

    config NET_PROBE_ENABLE
        bool "UDP link probe for tools/net_probe.py"
        default n
        help
            A receiver shaped like an AirPlay 1 stream (125 packets/s of ~1.4 KB) that counts
            loss, bursts of loss, gaps and jitter, and reports them to the PC once a second
            together with the internal DMA memory and esp_hosted's frame-copy counters.

            The port is unauthenticated and can switch where esp_hosted allocates its frame
            copies. Bench images only: set it through boards/<board>/sdkconfig.nettest
            (-DMODESP_NETTEST=ON), never in a shipping sdkconfig.

    config NET_PROBE_PORT
        int "UDP port"
        depends on NET_PROBE_ENABLE
        range 1024 65535
        default 5005

endmenu
```

## modules/ui_lvgl/Kconfig
```kconfig
menu "UI (LVGL)"

config UI_SCREENSHOT_OPEN
    bool "Serve GET /api/screenshot without the web login"
    default n
    help
        Development panels only. The screenshot route normally answers to the same
        Basic-auth login as the rest of /api/*. With this set it answers to anyone on
        the network, so that the person reviewing screens can fetch them by URL
        without holding the panel's password.

        Off by default and deliberately absent from boards/*/sdkconfig.board: set it
        in the local sdkconfig of the bench panel, never in a profile that ships. The
        firmware logs a warning at boot while it is on.

config UI_SCROLL_BENCH
    bool "Serve GET /api/ui/scrollbench: a timed, scripted scroll of a long list"
    default n
    help
        Development panels only. Scrolls 600 synthetic rows of a real list widget at a
        fixed speed for a few seconds and answers with the frame times, split into
        rendering, the flush (PPA rotation), the wait for the DMA2D copy and the list's
        own row recycling. It is how a change to the drawing path is judged: the same
        list, speed and duration on every build (src/ui_scroll_bench.cpp).

        The route answers WITHOUT the web login, like /api/screenshot under
        UI_SCREENSHOT_OPEN, and the firmware says so at WARN on every boot. Set it in the
        local sdkconfig of a bench build, never in a profile that ships.

config UI_DOUBLE_FB
    bool "Compose frames in the DSI panel's second frame buffer, shift scrolled lists"
    default y
    help
        With the rotated panel's direct PPA flush (src/ppa_flush.cpp): LVGL's blocks go
        into the frame buffer that is not on the glass, and the DPI driver switches to it
        when the frame is complete, so nothing tears. A list that scrolls (VList) is then
        moved by DMA2D inside the frame buffer, and LVGL draws only the strip that came
        into view: a scroll frame costs a strip's drawing and ~5 ms of copying instead of
        repainting the whole list (~70 ms here).

        Needs the panel driver to make two DPI frame buffers (num_fbs = 2); with one, or
        with this off, frames are drawn straight into the buffer on the glass, as before.

config UI_SHIFT_PRIORITY
    int "LVGL task priority while a frame shifts a scrolled list (0: unchanged)"
    depends on UI_DOUBLE_FB
    range 0 10
    default 2
    help
        A frame that shifts a list draws only the strip that came into view, a few ms of
        CPU. For those frames the LVGL task is raised to this priority, above the radio's
        decoder and the main loop that share its core at priority 1, so a scroll keeps the
        panel's 60 Hz under load; any other frame goes back to the port's priority. 0 keeps
        LVGL where the port put it.

config UI_M3_TEST_SCREEN
    bool "Put the Material 3 component test page in the menu"
    default n
    help
        Development only. Replaces the service screen's menu slot with a page that
        shows every component of src/ui_m3_widgets.h — buttons, chips, switch,
        slider, list rows, rail items, toast, the wavy line and the type roles — so
        the redesign's building blocks can be judged on the glass and by screenshot
        before a real screen is drawn with them (docs/PLAN_UI_M3_2026-09-24.md, U0).

endmenu
```

## tools/sdio_soak/main/Kconfig.projbuild
```kconfig
menu "SDIO soak test"

    config SOAK_URL
        string "Stream URL (http:// or https://)"
        default "https://icecast.radiofrance.fr/fip-midfi.mp3"
        help
            The stream to pull continuously. Run A (control): a FLAC/any large file on a
            LAN HTTP server (no internet, no TLS). Run B (real path): a public MP3 station
            over HTTPS. A finite file is re-opened when it ends (counted as `restart`).

    config SOAK_DURATION_MIN
        int "Test duration, minutes (0 = until reset)"
        default 120

    config SOAK_REPORT_SEC
        int "Report period, seconds"
        default 30

    config SOAK_RING_KB
        int "PSRAM ring buffer, KB"
        default 512
        help
            The consumer drains the ring at SOAK_DRAIN_KBPS; a stall shows up as the ring
            running empty. Big enough to hide short hiccups, small enough to expose stalls.

    config SOAK_DRAIN_KBPS
        int "Consumer drain rate, kbit/s (0 = drain as fast as data arrives)"
        default 128
        help
            Emulates the decoder pace. For the LAN file test set 0 (pure throughput) or a
            realistic FLAC rate (~1000).

    config SOAK_STALL_SEC
        int "Stall threshold: seconds without any received byte"
        default 5

    config SOAK_HTTP_TIMEOUT_MS
        int "HTTP socket timeout, ms"
        default 10000

    config SOAK_PHASE_MIN
        int "Phase length, minutes (0 = no phases, one steady run)"
        default 0
        help
            With phases enabled the test walks SOAK_BALLAST_TARGETS, holding each for this
            long and printing a SOAK PHASE line at the start and a SOAK PHASE END summary at
            the finish. The bit-rate axis is driven from the other end (rate_server.py), so
            one run can cover a whole grid without a reflash.

    config SOAK_BALLAST_TARGETS
        string "Free DMA-SRAM targets per phase, KB, comma separated (0 = no ballast)"
        default "0"
        help
            Before each phase the test allocates DMA-capable internal SRAM until no more than
            this much is free, emulating the memory pressure the display, LVGL and the audio
            core put on the same pool. The player itself runs at about 27 KB free
            (docs/CONCEPT.md section 8), which is the point of the exercise: the link is not
            measured in isolation on the real device. List the targets from most free to
            least, because the tight ones are the ones that can end the run.

    config SOAK_WIFI_SSID
        string "Wi-Fi SSID override (empty = take from the player's NVS)"
        default ""

    config SOAK_WIFI_PASS
        string "Wi-Fi password override (empty = take from the player's NVS)"
        default ""

endmenu
```
