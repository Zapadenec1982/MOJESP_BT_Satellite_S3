// Generated by tools/gen_country_names.py from Unicode CLDR 48.0.0 — do not edit.
// Data: Unicode CLDR, Unicode License v3 (https://www.unicode.org/license.txt).
// ISO 3166-1 alpha-2 code -> short name in uk, en, de, pl (ui.lang's order), sorted by code
// for a binary search.
{"AC", {"Острів Вознесіння", "Ascension Island", "Ascension", "Wyspa Wniebowstąpienia"}},
{"AD", {"Андорра", "Andorra", "Andorra", "Andora"}},
{"AE", {"Об’єднані Арабські Емірати", "United Arab Emirates", "Vereinigte Arabische Emirate", "Zjednoczone Emiraty Arabskie"}},
{"AF", {"Афганістан", "Afghanistan", "Afghanistan", "Afganistan"}},
{"AG", {"Антигуа і Барбуда", "Antigua & Barbuda", "Antigua und Barbuda", "Antigua i Barbuda"}},
{"AI", {"Ангілья", "Anguilla", "Anguilla", "Anguilla"}},
{"AL", {"Албанія", "Albania", "Albanien", "Albania"}},
{"AM", {"Вірменія", "Armenia", "Armenien", "Armenia"}},
{"AO", {"Ангола", "Angola", "Angola", "Angola"}},
{"AQ", {"Антарктика", "Antarctica", "Antarktis", "Antarktyda"}},
{"AR", {"Аргентина", "Argentina", "Argentinien", "Argentyna"}},
{"AS", {"Американське Самоа", "American Samoa", "Amerikanisch-Samoa", "Samoa Amerykańskie"}},
{"AT", {"Австрія", "Austria", "Österreich", "Austria"}},
{"AU", {"Австралія", "Australia", "Australien", "Australia"}},
{"AW", {"Аруба", "Aruba", "Aruba", "Aruba"}},
{"AX", {"Аландські Острови", "Åland Islands", "Ålandinseln", "Wyspy Alandzkie"}},
{"AZ", {"Азербайджан", "Azerbaijan", "Aserbaidschan", "Azerbejdżan"}},
{"BA", {"Боснія і Герцеговина", "Bosnia", "Bosnien und Herzegowina", "Bośnia i Hercegowina"}},
{"BB", {"Барбадос", "Barbados", "Barbados", "Barbados"}},
{"BD", {"Бангладеш", "Bangladesh", "Bangladesch", "Bangladesz"}},
{"BE", {"Бельгія", "Belgium", "Belgien", "Belgia"}},
{"BF", {"Буркіна-Фасо", "Burkina Faso", "Burkina Faso", "Burkina Faso"}},
{"BG", {"Болгарія", "Bulgaria", "Bulgarien", "Bułgaria"}},
{"BH", {"Бахрейн", "Bahrain", "Bahrain", "Bahrajn"}},
{"BI", {"Бурунді", "Burundi", "Burundi", "Burundi"}},
{"BJ", {"Бенін", "Benin", "Benin", "Benin"}},
{"BL", {"Сен-Бартелемі", "St. Barthélemy", "St. Barthélemy", "Saint-Barthélemy"}},
{"BM", {"Бермудські Острови", "Bermuda", "Bermuda", "Bermudy"}},
{"BN", {"Бруней", "Brunei", "Brunei Darussalam", "Brunei"}},
{"BO", {"Болівія", "Bolivia", "Bolivien", "Boliwia"}},
{"BQ", {"Карибські Нідерланди", "Caribbean Netherlands", "Karibische Niederlande", "Niderlandy Karaibskie"}},
{"BR", {"Бразилія", "Brazil", "Brasilien", "Brazylia"}},
{"BS", {"Багамські Острови", "Bahamas", "Bahamas", "Bahamy"}},
{"BT", {"Бутан", "Bhutan", "Bhutan", "Bhutan"}},
{"BV", {"Острів Буве", "Bouvet Island", "Bouvetinsel", "Wyspa Bouveta"}},
{"BW", {"Ботсвана", "Botswana", "Botsuana", "Botswana"}},
{"BY", {"Білорусь", "Belarus", "Belarus", "Białoruś"}},
{"BZ", {"Беліз", "Belize", "Belize", "Belize"}},
{"CA", {"Канада", "Canada", "Kanada", "Kanada"}},
{"CC", {"Кокосові (Кілінг) Острови", "Cocos Islands", "Kokosinseln", "Wyspy Kokosowe"}},
{"CD", {"Конго – Кіншаса", "Congo - Kinshasa", "Kongo-Kinshasa", "Demokratyczna Republika Konga"}},
{"CF", {"Центральноафриканська Республіка", "Central African Republic", "Zentralafrikanische Republik", "Republika Środkowoafrykańska"}},
{"CG", {"Конго – Браззавіль", "Congo - Brazzaville", "Kongo-Brazzaville", "Kongo"}},
{"CH", {"Швейцарія", "Switzerland", "Schweiz", "Szwajcaria"}},
{"CI", {"Кот-д’Івуар", "Côte d’Ivoire", "Côte d’Ivoire", "Côte d’Ivoire"}},
{"CK", {"Острови Кука", "Cook Islands", "Cookinseln", "Wyspy Cooka"}},
{"CL", {"Чилі", "Chile", "Chile", "Chile"}},
{"CM", {"Камерун", "Cameroon", "Kamerun", "Kamerun"}},
{"CN", {"Китай", "China", "China", "Chiny"}},
{"CO", {"Колумбія", "Colombia", "Kolumbien", "Kolumbia"}},
{"CP", {"Острів Кліппертон", "Clipperton Island", "Clipperton-Insel", "Wyspa Clippertona"}},
{"CQ", {"Сарк", "Sark", "Sark", "Sark"}},
{"CR", {"Коста-Рика", "Costa Rica", "Costa Rica", "Kostaryka"}},
{"CU", {"Куба", "Cuba", "Kuba", "Kuba"}},
{"CV", {"Кабо-Верде", "Cape Verde", "Cabo Verde", "Republika Zielonego Przylądka"}},
{"CW", {"Кюрасао", "Curaçao", "Curaçao", "Curaçao"}},
{"CX", {"Острів Різдва", "Christmas Island", "Weihnachtsinsel", "Wyspa Bożego Narodzenia"}},
{"CY", {"Кіпр", "Cyprus", "Zypern", "Cypr"}},
{"CZ", {"Чехія", "Czechia", "Tschechien", "Czechy"}},
{"DE", {"Німеччина", "Germany", "Deutschland", "Niemcy"}},
{"DG", {"Дієго-Гарсія", "Diego Garcia", "Diego Garcia", "Diego Garcia"}},
{"DJ", {"Джибуті", "Djibouti", "Dschibuti", "Dżibuti"}},
{"DK", {"Данія", "Denmark", "Dänemark", "Dania"}},
{"DM", {"Домініка", "Dominica", "Dominica", "Dominika"}},
{"DO", {"Домініканська Республіка", "Dominican Republic", "Dominikanische Republik", "Dominikana"}},
{"DZ", {"Алжир", "Algeria", "Algerien", "Algieria"}},
{"EA", {"Сеута і Мелілья", "Ceuta & Melilla", "Ceuta und Melilla", "Ceuta i Melilla"}},
{"EC", {"Еквадор", "Ecuador", "Ecuador", "Ekwador"}},
{"EE", {"Естонія", "Estonia", "Estland", "Estonia"}},
{"EG", {"Єгипет", "Egypt", "Ägypten", "Egipt"}},
{"EH", {"Західна Сахара", "Western Sahara", "Westsahara", "Sahara Zachodnia"}},
{"ER", {"Еритрея", "Eritrea", "Eritrea", "Erytrea"}},
{"ES", {"Іспанія", "Spain", "Spanien", "Hiszpania"}},
{"ET", {"Ефіопія", "Ethiopia", "Äthiopien", "Etiopia"}},
{"EU", {"Європейський Союз", "European Union", "Europäische Union", "Unia Europejska"}},
{"EZ", {"Єврозона", "Eurozone", "Eurozone", "strefa euro"}},
{"FI", {"Фінляндія", "Finland", "Finnland", "Finlandia"}},
{"FJ", {"Фіджі", "Fiji", "Fidschi", "Fidżi"}},
{"FK", {"Фолклендські Острови", "Falkland Islands", "Falklandinseln", "Falklandy"}},
{"FM", {"Мікронезія", "Micronesia", "Mikronesien", "Mikronezja"}},
{"FO", {"Фарерські Острови", "Faroe Islands", "Färöer", "Wyspy Owcze"}},
{"FR", {"Франція", "France", "Frankreich", "Francja"}},
{"GA", {"Габон", "Gabon", "Gabun", "Gabon"}},
{"GB", {"Велика Британія", "UK", "UK", "Wielka Brytania"}},
{"GD", {"Гренада", "Grenada", "Grenada", "Grenada"}},
{"GE", {"Грузія", "Georgia", "Georgien", "Gruzja"}},
{"GF", {"Французька Гвіана", "French Guiana", "Französisch-Guayana", "Gujana Francuska"}},
{"GG", {"Гернсі", "Guernsey", "Guernsey", "Guernsey"}},
{"GH", {"Гана", "Ghana", "Ghana", "Ghana"}},
{"GI", {"Гібралтар", "Gibraltar", "Gibraltar", "Gibraltar"}},
{"GL", {"Гренландія", "Greenland", "Grönland", "Grenlandia"}},
{"GM", {"Гамбія", "Gambia", "Gambia", "Gambia"}},
{"GN", {"Гвінея", "Guinea", "Guinea", "Gwinea"}},
{"GP", {"Гваделупа", "Guadeloupe", "Guadeloupe", "Gwadelupa"}},
{"GQ", {"Екваторіальна Гвінея", "Equatorial Guinea", "Äquatorialguinea", "Gwinea Równikowa"}},
{"GR", {"Греція", "Greece", "Griechenland", "Grecja"}},
{"GS", {"Південна Джорджія та Південні Сандвічеві Острови", "South Georgia & South Sandwich Islands", "Südgeorgien und die Südlichen Sandwichinseln", "Georgia Południowa i Sandwich Południowy"}},
{"GT", {"Гватемала", "Guatemala", "Guatemala", "Gwatemala"}},
{"GU", {"Гуам", "Guam", "Guam", "Guam"}},
{"GW", {"Гвінея-Бісау", "Guinea-Bissau", "Guinea-Bissau", "Gwinea Bissau"}},
{"GY", {"Гаяна", "Guyana", "Guyana", "Gujana"}},
{"HK", {"Гонконг", "Hong Kong", "Hongkong", "Hongkong"}},
{"HM", {"Острови Герд і Макдоналд", "Heard & McDonald Islands", "Heard und McDonaldinseln", "Wyspy Heard i McDonalda"}},
{"HN", {"Гондурас", "Honduras", "Honduras", "Honduras"}},
{"HR", {"Хорватія", "Croatia", "Kroatien", "Chorwacja"}},
{"HT", {"Гаїті", "Haiti", "Haiti", "Haiti"}},
{"HU", {"Угорщина", "Hungary", "Ungarn", "Węgry"}},
{"IC", {"Канарські Острови", "Canary Islands", "Kanarische Inseln", "Wyspy Kanaryjskie"}},
{"ID", {"Індонезія", "Indonesia", "Indonesien", "Indonezja"}},
{"IE", {"Ірландія", "Ireland", "Irland", "Irlandia"}},
{"IL", {"Ізраїль", "Israel", "Israel", "Izrael"}},
{"IM", {"Острів Мен", "Isle of Man", "Isle of Man", "Wyspa Man"}},
{"IN", {"Індія", "India", "Indien", "Indie"}},
{"IO", {"Британська територія в Індійському океані", "British Indian Ocean Territory", "Britisches Territorium im Indischen Ozean", "Brytyjskie Terytorium Oceanu Indyjskiego"}},
{"IQ", {"Ірак", "Iraq", "Irak", "Irak"}},
{"IR", {"Іран", "Iran", "Iran", "Iran"}},
{"IS", {"Ісландія", "Iceland", "Island", "Islandia"}},
{"IT", {"Італія", "Italy", "Italien", "Włochy"}},
{"JE", {"Джерсі", "Jersey", "Jersey", "Jersey"}},
{"JM", {"Ямайка", "Jamaica", "Jamaika", "Jamajka"}},
{"JO", {"Йорданія", "Jordan", "Jordanien", "Jordania"}},
{"JP", {"Японія", "Japan", "Japan", "Japonia"}},
{"KE", {"Кенія", "Kenya", "Kenia", "Kenia"}},
{"KG", {"Киргизстан", "Kyrgyzstan", "Kirgisistan", "Kirgistan"}},
{"KH", {"Камбоджа", "Cambodia", "Kambodscha", "Kambodża"}},
{"KI", {"Кірибаті", "Kiribati", "Kiribati", "Kiribati"}},
{"KM", {"Комори", "Comoros", "Komoren", "Komory"}},
{"KN", {"Сент-Кітс і Невіс", "St. Kitts & Nevis", "St. Kitts und Nevis", "Saint Kitts i Nevis"}},
{"KP", {"Північна Корея", "North Korea", "Nordkorea", "Korea Północna"}},
{"KR", {"Південна Корея", "South Korea", "Südkorea", "Korea Południowa"}},
{"KW", {"Кувейт", "Kuwait", "Kuwait", "Kuwejt"}},
{"KY", {"Кайманові Острови", "Cayman Islands", "Kaimaninseln", "Kajmany"}},
{"KZ", {"Казахстан", "Kazakhstan", "Kasachstan", "Kazachstan"}},
{"LA", {"Лаос", "Laos", "Laos", "Laos"}},
{"LB", {"Ліван", "Lebanon", "Libanon", "Liban"}},
{"LC", {"Сент-Люсія", "St. Lucia", "St. Lucia", "Saint Lucia"}},
{"LI", {"Ліхтенштейн", "Liechtenstein", "Liechtenstein", "Liechtenstein"}},
{"LK", {"Шрі-Ланка", "Sri Lanka", "Sri Lanka", "Sri Lanka"}},
{"LR", {"Ліберія", "Liberia", "Liberia", "Liberia"}},
{"LS", {"Лесото", "Lesotho", "Lesotho", "Lesotho"}},
{"LT", {"Литва", "Lithuania", "Litauen", "Litwa"}},
{"LU", {"Люксембург", "Luxembourg", "Luxemburg", "Luksemburg"}},
{"LV", {"Латвія", "Latvia", "Lettland", "Łotwa"}},
{"LY", {"Лівія", "Libya", "Libyen", "Libia"}},
{"MA", {"Марокко", "Morocco", "Marokko", "Maroko"}},
{"MC", {"Монако", "Monaco", "Monaco", "Monako"}},
{"MD", {"Молдова", "Moldova", "Republik Moldau", "Mołdawia"}},
{"ME", {"Чорногорія", "Montenegro", "Montenegro", "Czarnogóra"}},
{"MF", {"Сен-Мартен", "St. Martin", "St. Martin", "Saint-Martin"}},
{"MG", {"Мадагаскар", "Madagascar", "Madagaskar", "Madagaskar"}},
{"MH", {"Маршаллові Острови", "Marshall Islands", "Marshallinseln", "Wyspy Marshalla"}},
{"MK", {"Північна Македонія", "North Macedonia", "Nordmazedonien", "Macedonia Północna"}},
{"ML", {"Малі", "Mali", "Mali", "Mali"}},
{"MM", {"М’янма (Бірма)", "Myanmar", "Myanmar", "Mjanma (Birma)"}},
{"MN", {"Монголія", "Mongolia", "Mongolei", "Mongolia"}},
{"MO", {"Макао", "Macao", "Macau", "Makau"}},
{"MP", {"Північні Маріанські Острови", "Northern Mariana Islands", "Nördliche Marianen", "Mariany Północne"}},
{"MQ", {"Мартиніка", "Martinique", "Martinique", "Martynika"}},
{"MR", {"Мавританія", "Mauritania", "Mauretanien", "Mauretania"}},
{"MS", {"Монтсеррат", "Montserrat", "Montserrat", "Montserrat"}},
{"MT", {"Мальта", "Malta", "Malta", "Malta"}},
{"MU", {"Маврикій", "Mauritius", "Mauritius", "Mauritius"}},
{"MV", {"Мальдіви", "Maldives", "Malediven", "Malediwy"}},
{"MW", {"Малаві", "Malawi", "Malawi", "Malawi"}},
{"MX", {"Мексика", "Mexico", "Mexiko", "Meksyk"}},
{"MY", {"Малайзія", "Malaysia", "Malaysia", "Malezja"}},
{"MZ", {"Мозамбік", "Mozambique", "Mosambik", "Mozambik"}},
{"NA", {"Намібія", "Namibia", "Namibia", "Namibia"}},
{"NC", {"Нова Каледонія", "New Caledonia", "Neukaledonien", "Nowa Kaledonia"}},
{"NE", {"Нігер", "Niger", "Niger", "Niger"}},
{"NF", {"Острів Норфолк", "Norfolk Island", "Norfolkinsel", "Norfolk"}},
{"NG", {"Нігерія", "Nigeria", "Nigeria", "Nigeria"}},
{"NI", {"Нікарагуа", "Nicaragua", "Nicaragua", "Nikaragua"}},
{"NL", {"Нідерланди", "Netherlands", "Niederlande", "Holandia"}},
{"NO", {"Норвегія", "Norway", "Norwegen", "Norwegia"}},
{"NP", {"Непал", "Nepal", "Nepal", "Nepal"}},
{"NR", {"Науру", "Nauru", "Nauru", "Nauru"}},
{"NU", {"Ніуе", "Niue", "Niue", "Niue"}},
{"NZ", {"Нова Зеландія", "New Zealand", "Neuseeland", "Nowa Zelandia"}},
{"OM", {"Оман", "Oman", "Oman", "Oman"}},
{"PA", {"Панама", "Panama", "Panama", "Panama"}},
{"PE", {"Перу", "Peru", "Peru", "Peru"}},
{"PF", {"Французька Полінезія", "French Polynesia", "Französisch-Polynesien", "Polinezja Francuska"}},
{"PG", {"Папуа-Нова Гвінея", "Papua New Guinea", "Papua-Neuguinea", "Papua-Nowa Gwinea"}},
{"PH", {"Філіппіни", "Philippines", "Philippinen", "Filipiny"}},
{"PK", {"Пакистан", "Pakistan", "Pakistan", "Pakistan"}},
{"PL", {"Польща", "Poland", "Polen", "Polska"}},
{"PM", {"Сен-П’єр і Мікелон", "St. Pierre & Miquelon", "St. Pierre und Miquelon", "Saint-Pierre i Miquelon"}},
{"PN", {"Острови Піткерн", "Pitcairn", "Pitcairninseln", "Pitcairn"}},
{"PR", {"Пуерто-Рико", "Puerto Rico", "Puerto Rico", "Portoryko"}},
{"PS", {"Палестина", "Palestine", "Palästina", "Palestyna"}},
{"PT", {"Португалія", "Portugal", "Portugal", "Portugalia"}},
{"PW", {"Палау", "Palau", "Palau", "Palau"}},
{"PY", {"Парагвай", "Paraguay", "Paraguay", "Paragwaj"}},
{"QA", {"Катар", "Qatar", "Katar", "Katar"}},
{"QO", {"Віддалена Океанія", "Outlying Oceania", "Äußeres Ozeanien", "Oceania — wyspy dalekie"}},
{"RE", {"Реюньйон", "Réunion", "Réunion", "Reunion"}},
{"RO", {"Румунія", "Romania", "Rumänien", "Rumunia"}},
{"RS", {"Сербія", "Serbia", "Serbien", "Serbia"}},
{"RU", {"Росія", "Russia", "Russland", "Rosja"}},
{"RW", {"Руанда", "Rwanda", "Ruanda", "Rwanda"}},
{"SA", {"Саудівська Аравія", "Saudi Arabia", "Saudi-Arabien", "Arabia Saudyjska"}},
{"SB", {"Соломонові Острови", "Solomon Islands", "Salomonen", "Wyspy Salomona"}},
{"SC", {"Сейшельські Острови", "Seychelles", "Seychellen", "Seszele"}},
{"SD", {"Судан", "Sudan", "Sudan", "Sudan"}},
{"SE", {"Швеція", "Sweden", "Schweden", "Szwecja"}},
{"SG", {"Сінгапур", "Singapore", "Singapur", "Singapur"}},
{"SH", {"Острів Святої Єлени", "St. Helena", "St. Helena", "Wyspa Świętej Heleny"}},
{"SI", {"Словенія", "Slovenia", "Slowenien", "Słowenia"}},
{"SJ", {"Шпіцберген та Ян-Маєн", "Svalbard & Jan Mayen", "Spitzbergen und Jan Mayen", "Svalbard i Jan Mayen"}},
{"SK", {"Словаччина", "Slovakia", "Slowakei", "Słowacja"}},
{"SL", {"Сьєрра-Леоне", "Sierra Leone", "Sierra Leone", "Sierra Leone"}},
{"SM", {"Сан-Марино", "San Marino", "San Marino", "San Marino"}},
{"SN", {"Сенегал", "Senegal", "Senegal", "Senegal"}},
{"SO", {"Сомалі", "Somalia", "Somalia", "Somalia"}},
{"SR", {"Суринам", "Suriname", "Suriname", "Surinam"}},
{"SS", {"Південний Судан", "South Sudan", "Südsudan", "Sudan Południowy"}},
{"ST", {"Сан-Томе і Принсіпі", "São Tomé & Príncipe", "São Tomé und Príncipe", "Wyspy Świętego Tomasza i Książęca"}},
{"SV", {"Сальвадор", "El Salvador", "El Salvador", "Salwador"}},
{"SX", {"Сінт-Мартен", "Sint Maarten", "Sint Maarten", "Sint Maarten"}},
{"SY", {"Сирія", "Syria", "Syrien", "Syria"}},
{"SZ", {"Есватіні", "Eswatini", "Eswatini", "Eswatini"}},
{"TA", {"Трістан-да-Кунья", "Tristan da Cunha", "Tristan da Cunha", "Tristan da Cunha"}},
{"TC", {"Острови Теркс і Кайкос", "Turks & Caicos Islands", "Turks- und Caicosinseln", "Turks i Caicos"}},
{"TD", {"Чад", "Chad", "Tschad", "Czad"}},
{"TF", {"Французькі Південні Території", "French Southern Territories", "Französische Süd- und Antarktisgebiete", "Francuskie Terytoria Południowe i Antarktyczne"}},
{"TG", {"Того", "Togo", "Togo", "Togo"}},
{"TH", {"Таїланд", "Thailand", "Thailand", "Tajlandia"}},
{"TJ", {"Таджикистан", "Tajikistan", "Tadschikistan", "Tadżykistan"}},
{"TK", {"Токелау", "Tokelau", "Tokelau", "Tokelau"}},
{"TL", {"Тимор-Лешті", "Timor-Leste", "Timor-Leste", "Timor Wschodni"}},
{"TM", {"Туркменістан", "Turkmenistan", "Turkmenistan", "Turkmenistan"}},
{"TN", {"Туніс", "Tunisia", "Tunesien", "Tunezja"}},
{"TO", {"Тонга", "Tonga", "Tonga", "Tonga"}},
{"TR", {"Туреччина", "Türkiye", "Türkei", "Turcja"}},
{"TT", {"Тринідад і Тобаго", "Trinidad & Tobago", "Trinidad und Tobago", "Trynidad i Tobago"}},
{"TV", {"Тувалу", "Tuvalu", "Tuvalu", "Tuvalu"}},
{"TW", {"Тайвань", "Taiwan", "Taiwan", "Tajwan"}},
{"TZ", {"Танзанія", "Tanzania", "Tansania", "Tanzania"}},
{"UA", {"Україна", "Ukraine", "Ukraine", "Ukraina"}},
{"UG", {"Уганда", "Uganda", "Uganda", "Uganda"}},
{"UM", {"Віддалені острови США", "U.S. Outlying Islands", "Amerikanische Überseeinseln", "Dalekie Wyspy Mniejsze Stanów Zjednoczonych"}},
{"UN", {"ООН", "UN", "UN", "ONZ"}},
{"US", {"США", "US", "USA", "USA"}},
{"UY", {"Уругвай", "Uruguay", "Uruguay", "Urugwaj"}},
{"UZ", {"Узбекистан", "Uzbekistan", "Usbekistan", "Uzbekistan"}},
{"VA", {"Ватикан", "Vatican City", "Vatikanstadt", "Watykan"}},
{"VC", {"Сент-Вінсент і Гренадіни", "St. Vincent & Grenadines", "St. Vincent und die Grenadinen", "Saint Vincent i Grenadyny"}},
{"VE", {"Венесуела", "Venezuela", "Venezuela", "Wenezuela"}},
{"VG", {"Британські Віргінські острови", "British Virgin Islands", "Britische Jungferninseln", "Brytyjskie Wyspy Dziewicze"}},
{"VI", {"Віргінські Острови (США)", "U.S. Virgin Islands", "Amerikanische Jungferninseln", "Wyspy Dziewicze Stanów Zjednoczonych"}},
{"VN", {"В’єтнам", "Vietnam", "Vietnam", "Wietnam"}},
{"VU", {"Вануату", "Vanuatu", "Vanuatu", "Vanuatu"}},
{"WF", {"Уолліс і Футуна", "Wallis & Futuna", "Wallis und Futuna", "Wallis i Futuna"}},
{"WS", {"Самоа", "Samoa", "Samoa", "Samoa"}},
{"XA", {"Псевдоакценти", "Pseudo-Accents", "Pseudo-Akzente", "Pseudoakcenty"}},
{"XB", {"Псевдобіді", "Pseudo-Bidi", "Pseudo-Bidi", "Pseudodwukierunkowe"}},
{"XK", {"Косово", "Kosovo", "Kosovo", "Kosowo"}},
{"YE", {"Ємен", "Yemen", "Jemen", "Jemen"}},
{"YT", {"Майотта", "Mayotte", "Mayotte", "Majotta"}},
{"ZA", {"Південно-Африканська Республіка", "South Africa", "Südafrika", "Republika Południowej Afryki"}},
{"ZM", {"Замбія", "Zambia", "Sambia", "Zambia"}},
{"ZW", {"Зімбабве", "Zimbabwe", "Simbabwe", "Zimbabwe"}},
{"ZZ", {"Невідомий регіон", "Unknown Region", "Unbekannte Region", "Nieznany region"}},
